## coral-dev/conf/bblayers.conf
```bitbake
LCONF_VERSION = "6"

BBPATH = "${TOPDIR}"
BSPDIR := "${@os.path.abspath(os.path.dirname(d.getVar('FILE', True)) + '/../..')}"

BBFILES ?= ""
BBLAYERS = " \
  ${BSPDIR}/sources/poky/meta \
  ${BSPDIR}/sources/poky/meta-poky \
  \
  ${BSPDIR}/sources/meta-openembedded/meta-oe \
  ${BSPDIR}/sources/meta-openembedded/meta-multimedia \
  ${BSPDIR}/sources/meta-openembedded/meta-python \
  \
  ${BSPDIR}/sources/meta-freescale \
  ${BSPDIR}/sources/meta-freescale-3rdparty \
  ${BSPDIR}/sources/meta-freescale-distro \
"
BBLAYERS += "${BSPDIR}/sources/meta-clang"
BBLAYERS += "${BSPDIR}/sources/meta-coral/meta-coral-bsp"
BBLAYERS += "${BSPDIR}/sources/meta-coral/meta-coral-demo"
#BBLAYERS += "/root/coral/build/workspace"
BBLAYERS += "/root/coral/build/workspace"
```

## coral-dev/conf/local.conf
```bitbake
MACHINE ??= 'coral-dev'
DISTRO ?= 'fslc-xwayland'
PACKAGE_CLASSES ?= 'package_rpm'
EXTRA_IMAGE_FEATURES ?= "debug-tweaks"
USER_CLASSES ?= "buildstats image-mklibs image-prelink"
PATCHRESOLVE = "noop"
BB_DISKMON_DIRS ??= "\
    STOPTASKS,${TMPDIR},1G,100K \
    STOPTASKS,${DL_DIR},1G,100K \
    STOPTASKS,${SSTATE_DIR},1G,100K \
    STOPTASKS,/tmp,100M,100K \
    ABORT,${TMPDIR},100M,1K \
    ABORT,${DL_DIR},100M,1K \
    ABORT,${SSTATE_DIR},100M,1K \
    ABORT,/tmp,10M,1K"
PACKAGECONFIG_append_pn-qemu-system-native = " sdl"
CONF_VERSION = "1"

#DISTRO_FEATURES += "wayland"

IMAGE_INSTALL_append = " opencv clutter-1.0 clutter-gst-3.0 clutter-gtk-1.0 openssh-sftp-server python3-edgetpu-examples nano"
IMAGE_INSTALL_append = " openssh"
# TOOLCHAIN_TARGET_TASK_append = " kernel-devsrc"

#LINUX_VERSION_EXTENSION = "-coral"



#BBMASK +="imx-gpu-apitrace"
#BBMASK +="packagegroup-fsl-tools-gpu"
#requires_coral-demo-image_remove = "packagegroup-fsl-tools-gpu"

DL_DIR ?= "${BSPDIR}/downloads/"
ACCEPT_FSL_EULA = "1"
```
